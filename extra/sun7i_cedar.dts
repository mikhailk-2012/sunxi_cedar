	reserved-memory {
		#address-cells = <1>;
		#size-cells = <1>;
		ranges;
		/* Address must be kept in the lower 256 MiBs of DRAM for VE. */
		default-pool {
			compatible = "shared-dma-pool";
			size = <0x6000000>;
			alloc-ranges = <0x4a000000 0x6000000>;
			reusable;
			linux,cma-default;
		};
		/* memory region for cedar video codec */
		ve_reserved: cma@0x50000000 {
			compatible = "shared-dma-pool";
			size = <0x5000000>;
			alloc-ranges = <0x50000000 0x5000000>;  /* 80M */
			reusable;
		};
	};

...

		ve: video-engine@01c0e000 {
			compatible = "allwinner,sunxi-cedar";
			reg = <0x01c0e000 0x1000>;
			memory-region = <&ve_reserved>;

			clocks = <&ccu CLK_AHB_VE>, <&ccu CLK_VE>,
				<&ccu CLK_DRAM_VE>;
			clock-names = "ahb", "mod", "ram";

			assigned-clocks = <&ccu CLK_VE>;
			assigned-clock-rates = <320000000>;

			resets = <&ccu RST_VE>;
			interrupts = <GIC_SPI 53 IRQ_TYPE_LEVEL_HIGH>;
		};
